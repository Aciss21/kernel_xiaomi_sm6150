## drivers/block/zram/Kconfig
```kconfig
# SPDX-License-Identifier: GPL-2.0
config ZRAM
	tristate "Compressed RAM block device support"
	depends on BLOCK && SYSFS && ZSMALLOC && CRYPTO
	select CRYPTO_LZO
	default n
	help
	  Creates virtual block devices called /dev/zramX (X = 0, 1, ...).
	  Pages written to these disks are compressed and stored in memory
	  itself. These disks allow very fast I/O and compression provides
	  good amounts of memory savings.

	  It has several use cases, for example: /tmp storage, use as swap
	  disks and maybe many more.

	  See Documentation/blockdev/zram.txt for more information.

config ZRAM_DEDUP
	bool "Deduplication support for ZRAM data"
	depends on ZRAM
	select XXHASH
	default n
	help
	  Deduplicate ZRAM data to reduce amount of memory consumption.
	  Advantage largely depends on the workload. In some cases, this
          option reduces memory usage to the half. However, if there is no
	  duplicated data, the amount of memory consumption would be
	  increased due to additional metadata usage. And, there is
	  computation time trade-off. Please check the benefit before
	  enabling this option. Experiment shows the positive effect when
	  the zram is used as blockdev and is used to store build output.

config ZRAM_WRITEBACK
       bool "Write back incompressible or idle page to backing device"
       depends on ZRAM
       default n
       help
	 With incompressible page, there is no memory saving to keep it
	 in memory. Instead, write it out to backing device.
	 For this feature, admin should set up backing device via
	 /sys/block/zramX/backing_dev.

	 With /sys/block/zramX/{idle,writeback}, application could ask
	 idle page's writeback to the backing device to save in memory.

	 See Documentation/blockdev/zram.txt for more information.

config ZRAM_MEMORY_TRACKING
	bool "Track zRam block status"
	depends on ZRAM && DEBUG_FS
	help
	  With this feature, admin can track the state of allocated blocks
	  of zRAM. Admin could see the information via
	  /sys/kernel/debug/zram/zramX/block_state.

	  See Documentation/blockdev/zram.txt for more information.

config ZRAM_DEFAULT_COMP_ALGORITHM
	string "Default ZRAM compression algorithm"
	depends on ZRAM
	default "lzo"
	help
	  Compression algorithm used by newly created zram devices.  The
	  algorithm still has to be available in the kernel crypto API.
	  LZ4 offers much lower compression/decompression latency than LZO
	  at a slightly lower compression ratio, which is usually the right
	  trade-off for a swap device.

config ZRAM_ENTROPY
	bool "Use entropy optimization for zram"
	depends on ZRAM
	help
	  With this feature, entropy will be calculated for each page.
	  Pages above ZRAM_ENTROPY_THRESHOLD entropy will be
	  stored uncompressed. Use this feature if you need a performance
	  boost and a small loss in compression.

config ZRAM_ENTROPY_THRESHOLD
	int
	depends on ZRAM && ZRAM_ENTROPY
	default 100000
	help
	  Pages with entropy above ZRAM_ENTROPY_THRESHOLD will be stored
	  uncompressed. The default value was chosen as a reasonable balance 
	  between compression ratio and performance.

config ZRAM_MULTI_COMP
	bool "Enable multiple compression streams"
	depends on ZRAM
	help
	  BACKPORT (mainline v6.2): allow a zram device to be configured with
	  more than one compression algorithm. The primary algorithm is used on
	  the write (swap-out) path as before; up to three additional secondary
	  algorithms can be assigned via /sys/block/zramX/recomp_algorithm and
	  applied to idle/cold pages with /sys/block/zramX/recompress to trade a
	  little CPU for a better compression ratio.

	  When disabled, zram behaves exactly as before (single algorithm).

	  See Documentation/blockdev/zram.txt for more information.

config ZRAM_DEFAULT_RECOMP_ALGORITHM
	string "Default secondary ZRAM compression algorithm"
	depends on ZRAM && ZRAM_MULTI_COMP
	default "lzo"
	help
	  Compression algorithm used for automatic recompression.  This is
	  the secondary algorithm; the primary algorithm configured with
	  ZRAM_DEFAULT_COMP_ALGORITHM is still used for new writes.

	  LZO is a good default because it is already selected by ZRAM and
	  is fast enough for background recompression.  A slower algorithm
	  such as deflate can save more memory, but it also makes reads of
	  recompressed pages slower.  Leave this empty to disable the
	  default secondary algorithm.

config ZRAM_AUTO_RECOMP
	bool "Automatically recompress idle ZRAM pages"
	depends on ZRAM && ZRAM_MULTI_COMP
	default y
	help
	  Periodically recompress pages that remain untouched for one full
	  interval.  This runs in small batches in the background, so it
	  does not need a userspace daemon and does not block the normal
	  zram read/write path.

	  Pages are marked on one pass and recompressed on the next only if
	  they have not been accessed in between.  A separate candidate
	  flag is used, so this does not mark pages idle for writeback.
	  Disable this if you want to use only the manual recompress sysfs
	  interface.

config ZRAM_AUTO_RECOMP_INTERVAL
	int "Seconds between automatic ZRAM recompression passes"
	depends on ZRAM && ZRAM_MULTI_COMP && ZRAM_AUTO_RECOMP
	range 5 3600
	default 30
	help
	  Delay between background recompression passes.  A page must stay
	  untouched for at least one interval before it is recompressed.

config ZRAM_AUTO_RECOMP_PAGES
	int "Pages scanned per automatic ZRAM recompression pass"
	depends on ZRAM && ZRAM_MULTI_COMP && ZRAM_AUTO_RECOMP
	range 64 65536
	default 2048
	help
	  Number of slots examined in each background pass.  Keep this
	  modest so recompression stays a low-priority background activity.
```

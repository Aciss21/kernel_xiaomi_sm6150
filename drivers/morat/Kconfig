## drivers/morat/exoticaffinity/Kconfig
```kconfig
config EXOTIC_AFFINITY
    tristate "ExoticAffinity: Pin critical threads to LITTLE cores"
    default y
```

## drivers/morat/exoticappboost/Kconfig
```kconfig
config MORAT_EXOTIC_APPBOOST
	bool "Exotic App Boost"
	default y
	help
	  Automatically prioritize important apps to improve launch time.
```
